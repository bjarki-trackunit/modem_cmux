## CMakeLists.txt
```
# SPDX-License-Identifier: Apache-2.0

cmake_minimum_required(VERSION 3.20.0)
find_package(Zephyr REQUIRED HINTS $ENV{ZEPHYR_BASE})
project(net_test)

target_sources(app PRIVATE src/main.c src/modem_pipe_uart.c src/modem_cmux.c src/modem_cmd.c src/modem_ppp.c src/modem_shell.cpp)
target_include_directories(app PRIVATE inc)
```

## prj.conf
```kconfig
CONFIG_GPIO=y
CONFIG_UART_STM32=y
CONFIG_UART_INTERRUPT_DRIVEN=y
CONFIG_RING_BUFFER=y
CONFIG_NO_OPTIMIZATIONS=y
CONFIG_EVENTS=y
CONFIG_MAIN_STACK_SIZE=8192
CONFIG_NET_L2_PPP_TX_STACK_SIZE=8192
CONFIG_SYSTEM_WORKQUEUE_STACK_SIZE=8192
CONFIG_NET_RX_STACK_SIZE=8192

CONFIG_NET_L2_PPP=y
CONFIG_NETWORKING=y
CONFIG_LOG=y
CONFIG_NET_LOG=y
CONFIG_LOG_DEFAULT_LEVEL=4
CONFIG_LOG_BUFFER_SIZE=8192

#CONFIG_THREAD_ANALYZER=y
#CONFIG_THREAD_ANALYZER_USE_LOG=y
#CONFIG_THREAD_ANALYZER_AUTO=y
#CONFIG_THREAD_ANALYZER_AUTO_INTERVAL=5

CONFIG_NET_UDP=y
CONFIG_DNS_RESOLVER=y
CONFIG_NET_SOCKETS=y
CONFIG_NET_IPV4=y

# Network monitoring
CONFIG_NET_MGMT=y
CONFIG_NET_MGMT_EVENT=y
CONFIG_NET_CONNECTION_MANAGER=y
CONFIG_NET_MGMT_EVENT_STACK_SIZE=4096

CONFIG_ASSERT=y

# Shell:
CONFIG_SHELL=y
CONFIG_SHELL_STACK_SIZE=4096
CONFIG_MODEM_SHELL=y
CONFIG_NET_SHELL=y
CONFIG_SHELL_WILDCARD=n
```

## inc/modem_cmd.h
```c
/*
 * Copyright (c) 2022 Trackunit Corporation
 *
 * SPDX-License-Identifier: Apache-2.0
 */

#include <zephyr/kernel.h>
#include <zephyr/types.h>
#include <zephyr/device.h>
#include <zephyr/sys/ring_buffer.h>

#include "modem_pipe.h"

#ifndef ZEPHYR_DRIVERS_MODEM_MODEM_CMD
#define ZEPHYR_DRIVERS_MODEM_MODEM_CMD

struct modem_cmd;

/**
 * @brief Callback called when matching command is received
 *
 * @param cmd Pointer to command handler instance
 * @param argv Pointer to array of parsed arguments
 * @param argc Number of parsed arguments, arg 0 holds the exact match
 * @param user_data Free to use user data set during modem_cmd_init()
 */
typedef void (*modem_cmd_match_callback)(struct modem_cmd *cmd, char **argv, uint16_t argc,
					 void *user_data);

/**
 * @brief Modem command match
 */
struct modem_cmd_match {
	/* Match array */
	const uint8_t *match;
	const uint8_t match_size;

	/* Separators array */
	const uint8_t *separators;
	const uint8_t separators_size;

	/* Set if modem command handler shall use wildcards when matching */
	const bool wildcards;

	/* Type of modem command handler */
	const modem_cmd_match_callback callback;

	/* Used by matching algorithm */
	bool matching;
};

#define MODEM_CMD_MATCH(_match, _separators, _callback)                 \
	{                                                               \
		.match = (uint8_t *)(_match),                           \
		.match_size = (uint8_t)(sizeof(_match) - 1),            \
		.separators = (uint8_t *)(_separators),                 \
		.separators_size = (uint8_t)(sizeof(_separators) - 1),  \
		.wildcards = false,                                     \
		.callback = _callback,                                  \
		.matching = false,                                      \
	}

#define MODEM_CMD_MATCH_WILDCARD(_match, _separators, _callback)        \
	{                                                               \
		.match = (uint8_t *)(_match),                           \
		.match_size = (uint8_t)(sizeof(_match) - 1),            \
		.separators = (uint8_t *)(_separators),                 \
		.separators_size = (uint8_t)(sizeof(_separators) - 1),  \
		.wildcards = true,                                      \
		.callback = _callback,                                  \
		.matching = false,                                      \
	}

/**
 * @brief Modem command script command
 *
 * @param request Request to send to modem formatted as char string
 * @param response Expected response to request
 */
struct modem_cmd_script_cmd {
	const char *request;
	struct modem_cmd_match response_match;
};

#define MODEM_CMD_SCRIPT_CMD(_request, _response_match)                 \
	{                                                               \
		.request = _request,                                    \
		.response_match = _response_match,             	        \
	}

/**
 * @brief Modem command script
 *
 * @param name Name of script
 * @param name_size Size of name of script
 * @param script_cmds Array of script commands
 * @param script_cmds_size Elements in array of script commands
 * @param abort_matches Array of abort matches
 * @param abort_matches_size Elements in array of abort matches
 *
 * @example
 *
 * static script1_cmds = {
 *         MODEM_CMD_SCRIPT_CMD("AT", MODEM_CMD_MATCH("OK", "", NULL)),
 *         MODEM_CMD_SCRIPT_CMD("ATI", MODEM_CMD_MATCH("OK", "", NULL)),
 * };
 *
 * static script1_abort_matches = {
 *         MODEM_CMD_MATCH("ERROR", ",", on_error),
 *         MODEM_CMD_MATCH("NO CARRIER", "", on_no_carrier),
 * };
 *
 * static MODEM_CMD_SCRIPT_DEFINE(script1, script1_cmds, script1_abort_matches);
 */
struct modem_cmd_script {
	const char *name;
	struct modem_cmd_script_cmd *const script_cmds;
	const uint16_t script_cmds_size;
	struct modem_cmd_match *const abort_matches;
	const uint16_t abort_matches_size;
};

/* DEPRECATED */
#define MODEM_CMD_SCRIPT(_script_cmds, _abort_matches)                  \
	{                                                               \
		.name = "",                                             \
		.script_cmds = _script_cmds,                            \
		.script_cmds_size = ARRAY_SIZE(_script_cmds),           \
		.abort_matches = _abort_matches,                        \
		.abort_matches_size = ARRAY_SIZE(_abort_matches),       \
	}

#define MODEM_CMD_SCRIPT_DEFINE(_sym, _script_cmds, _abort_matches)     \
	struct modem_cmd_script _sym = {                                \
		.name = #_sym,                                          \
		.script_cmds = _script_cmds,                            \
		.script_cmds_size = ARRAY_SIZE(_script_cmds),           \
		.abort_matches = _abort_matches,                        \
		.abort_matches_size = ARRAY_SIZE(_abort_matches),       \
	}

/**
 * @brief Process work item
 *
 * @note k_work struct must be placed first
 */
struct modem_cmd_work_item {
	struct k_work_delayable dwork;
	struct modem_cmd *cmd;
};

/**
 * @brief Script run work item
 *
 * @param work Work item
 * @param cmd Modem command instance
 * @param script Pointer to new script to run
 *
 * @note k_work struct must be placed first
 */
struct modem_cmd_script_run_work_item {
	struct k_work work;
	struct modem_cmd *cmd;
	const struct modem_cmd_script *script;
};

/**
 * @brief Script abort work item
 *
 * @param work Work item
 * @param cmd Modem command instance
 *
 * @note k_work struct must be placed first
 */
struct modem_cmd_script_abort_work_item {
	struct k_work work;
	struct modem_cmd *cmd;
};

/**
 * @brief Modem command internal context
 * @warning Do not mopdify any members of this struct directly
 */
struct modem_cmd {
	/* Pipe used to send and receive data */
	struct modem_pipe *pipe;

	/* User data passed with match callbacks */
	void *user_data;

	/* Receive buffer */
	uint8_t *receive_buf;
	uint16_t receive_buf_size;
	uint16_t receive_buf_len;

	/* Work buffer */
	uint8_t work_buf[32];
	uint16_t work_buf_len;

	/* Command delimiter */
	uint8_t *delimiter;
	uint16_t delimiter_size;
	uint16_t delimiter_match_len;

	/* Parsed arguments */
	uint8_t **argv;
	uint16_t argv_size;
	uint16_t argc;

	/* Matches
	 * Index 0 -> Response matches
	 * Index 1 -> Abort matches
	 * Index 2 -> Unsolicited matches
	 */
	struct modem_cmd_match *matches[3];
	uint16_t matches_size[3];

	/* Script execution */
	const struct modem_cmd_script *script;
	struct modem_cmd_script_run_work_item script_run_work;
	struct modem_cmd_script_abort_work_item script_abort_work;
	uint16_t script_cmd_it;
	struct k_event script_event;

	/* Match parsing */
	struct modem_cmd_match *parse_match;
	uint16_t parse_match_len;
	uint16_t parse_arg_len;
	uint16_t parse_match_type;

	/* Process received data */
	struct modem_cmd_work_item process_work;
	k_timeout_t process_timeout;
};

/**
 * @brief Modem command configuration
 *
 * @param user_data Free to use data passed with modem match callbacks
 * @param receive_buf Receive buffer used to store parsed arguments
 * @param receive_buf_size Size of receive buffer should be longest line + longest match
 * @param delimiter Delimiter
 * @param delimiter_size Size of delimiter
 * @param argv Array of pointers used to point to parsed arguments
 * @param argv_size Elements in array of pointers
 * @param unsol_matches Array of unsolicited matches
 * @param unsol_matches_size Elements in array of unsolicited matches
 * @param process_timeout Delay from receive ready event to pipe receive occurs
 */
struct modem_cmd_config {
	void *user_data;
	uint8_t *receive_buf;
	uint16_t receive_buf_size;
	uint8_t *delimiter;
	uint16_t delimiter_size;
	uint8_t **argv;
	uint16_t argv_size;
	struct modem_cmd_match *unsol_matches;
	uint16_t unsol_matches_size;
	k_timeout_t process_timeout;
};

/**
 * @brief Initialize modem pipe command handler
 * @note Command handler must be attached to pipe
 */
int modem_cmd_init(struct modem_cmd *cmd, const struct modem_cmd_config *config);

/**
 * @brief Attach modem command handler to pipe
 *
 * @returns 0 if successful
 * @returns negative errno code if failure
 *
 * @note Command handler is enabled if successful
 */
int modem_cmd_attach(struct modem_cmd *cmd, struct modem_pipe *pipe);

/**
 * @brief Run script
 *
 * @param cmd Modem command instance
 * @param script Script to run
 *
 * @returns 0 if successful
 * @returns -EBUSY if a script is currently running
 * @returns -EPERM if modem pipe is not attached
 * @returns -EINVAL if arguments or script is invalid
 *
 * @note Script runs asynchronously until complete or aborted.
 * @note Use modem_cmd_script_wait() to synchronize with script termination
 */
int modem_cmd_script_run(struct modem_cmd *cmd, const struct modem_cmd_script *script);

/**
 * @brief Abort script
 *
 * @param cmd Modem command instance
 *
 * @note Use modem_cmd_script_wait() to synchronize with script termination
 */
void modem_cmd_script_abort(struct modem_cmd *cmd);

/**
 * @brief Wait until script execution complete
 *
 * @param cmd Modem command instance
 *
 * @returns 0 if script is terminated within timeout
 * @returns -EAGAIN if script is aborted within timeout
 * @returns -EBUSY if timeout elapses while script is still running
 *
 * @note To check status of script, set timeout to K_NO_WAIT
 */
int modem_cmd_script_wait(struct modem_cmd *cmd, k_timeout_t timeout);

/* DEPRECATED */
/**
 * @brief Send command to modem asynchronously
 *
 * @param cmd Modem command instance
 * @param str Command to send without delimiter
 *
 * @returns 0 if successful
 * @returns negative errno code if failure
 */
int modem_cmd_send(struct modem_cmd *cmd, const char *str);

/* DEPRECATED */
/**
 * @brief Send command to modem synchronously using event
 *
 * @param cmd Modem command instance
 * @param str Command to send without delimiter
 * @param event Event object to await
 * @param events Events to await
 * @param timeout Timeout within which any event must occur
 *
 * @returns Set of matching events if successful
 * @returns 0 if timeout occurs
 *
 * @note Events will be cleared before sending command
 */
uint32_t modem_cmd_send_sync_event(struct modem_cmd *cmd, const char *str, struct k_event *event,
				   uint32_t events, k_timeout_t timeout);

/**
 * @brief Release pipe from command handler
 * @note Command handler is now disabled
 */
int modem_cmd_release(struct modem_cmd *cmd);

#endif /* ZEPHYR_DRIVERS_MODEM_MODEM_PIPE_CMD */
```

## inc/modem_cmux.h
```c
/*
 * Copyright (c) 2022 Trackunit Corporation
 *
 * SPDX-License-Identifier: Apache-2.0
 */

/*
 * This library uses CMUX to create multiple data channels, called DLCIs, on a single serial bus.
 * Each DLCI has an address from 1 to 63. DLCI address 0 is reserved for control commands.
 *
 * Design overview:
 *
 *     DLCI1 <-----------+                              +-------> DLCI1
 *                       v                              v
 *     DLCI2 <---> CMUX instance <--> Serial bus <--> Client <--> DLCI2
 *                       ^                              ^
 *     DLCI3 <-----------+                              +-------> DLCI3
 *
 * Writing to and from the CMUX instances is done using a generic PIPE interface.
 */

#include <zephyr/kernel.h>
#include <zephyr/types.h>
#include <zephyr/sys/ring_buffer.h>

#include "modem_pipe.h"

#ifndef ZEPHYR_DRIVERS_MODEM_MODEM_CMUX
#define ZEPHYR_DRIVERS_MODEM_MODEM_CMUX

struct modem_cmux;

enum modem_cmux_event_type {
	MODEM_CMUX_EVENT_CONNECTED = 0,
	MODEM_CMUX_EVENT_DISCONNECTED,
	MODEM_CMUX_EVENT_OPENED,
	MODEM_CMUX_EVENT_CLOSED,
	MODEM_CMUX_EVENT_MODEM_STATUS,
};

struct modem_cmux_event {
	uint16_t dlci_address;
	enum modem_cmux_event_type type;
};

/**
 * @brief Event handler invoked when CMUX event occurs
 * @warning The priority of the context invoking this event (calling modem_cmux_process()) must be
 * equal to or higher than the context which owns the CMUX context.
 */
typedef void (*modem_cmux_event_handler_t)(struct modem_cmux *cmux, struct modem_cmux_event event,
					   void *user_data);

enum modem_cmux_dlci_state {
	MODEM_CMUX_DLCI_STATE_CLOSED = 0,
	MODEM_CMUX_DLCI_STATE_OPENING,
	MODEM_CMUX_DLCI_STATE_OPEN,
	MODEM_CMUX_DLCI_STATE_CLOSING,
};

enum modem_cmux_receive_state {
	MODEM_CMUX_RECEIVE_STATE_SOF = 0,
	MODEM_CMUX_RECEIVE_STATE_ADDRESS,
	MODEM_CMUX_RECEIVE_STATE_ADDRESS_CONT,
	MODEM_CMUX_RECEIVE_STATE_CONTROL,
	MODEM_CMUX_RECEIVE_STATE_LENGTH,
	MODEM_CMUX_RECEIVE_STATE_LENGTH_CONT,
	MODEM_CMUX_RECEIVE_STATE_DATA,
	MODEM_CMUX_RECEIVE_STATE_FCS,
	MODEM_CMUX_RECEIVE_STATE_EOF,
};

/**
 * @brief CMUX DLCI channel context data
 * @warning Do not modify any members of this object directly
 */
struct modem_cmux_dlci {
	/* Configuration */
	uint16_t dlci_address;
	struct modem_cmux *cmux;
	struct modem_pipe *pipe;
	modem_pipe_event_handler_t pipe_event_handler;
	void *pipe_event_handler_user_data;

	/* Receive buffer */
	struct ring_buf receive_rb;
	struct k_mutex receive_rb_lock;

	/* State */
	enum modem_cmux_dlci_state state;
	bool allocated;
};

/**
 * @brief CMUX frame
 * @warning Do not modify any members of this object directly
 */
struct modem_cmux_frame {
	uint16_t dlci_address;
	bool cr;
	bool pf;
	uint8_t type;
	const uint8_t *data;
	uint16_t data_len;
};

enum modem_cmux_state {
	MODEM_CMUX_STATE_DISCONNECTED = 0,
	MODEM_CMUX_STATE_CONNECTING,
	MODEM_CMUX_STATE_CONNECTED,
	MODEM_CMUX_STATE_DISCONNECTING,
};

struct modem_cmux_work_delayable {
	struct k_work_delayable dwork;
	struct modem_cmux *cmux;
};

/**
 * @brief CMUX context data
 * @warning Do not modify any members of this object directly
 */
struct modem_cmux {
	/* Bus pipe */
	struct modem_pipe *pipe;

	/* Event handler */
	modem_cmux_event_handler_t event_handler;
	void *event_handler_user_data;

	/* Synchronization */
	struct k_mutex lock;

	/* DLCI channel contexts */
	struct modem_cmux_dlci *dlcis;
	uint16_t dlcis_cnt;

	/* Status */
	enum modem_cmux_state state;

	/* Receive state*/
	enum modem_cmux_receive_state receive_state;

	/* Receive buffer */
	uint8_t *receive_buf;
	uint16_t receive_buf_size;
	uint16_t receive_buf_len;

	/* Work buffer */
	uint8_t work_buf[64];
	uint16_t work_buf_len;

	/* Received frame */
	struct modem_cmux_frame frame;
	uint8_t frame_header[5];
	uint16_t frame_header_len;

	/* Work */
	struct modem_cmux_work_delayable process_received;
	k_timeout_t receive_timeout;
};

/**
 * @brief Contains CMUX instance confuguration data
 * @param event_handler Invoked when event occurs
 * @param event_handler_user_data Free to use pointer passed to event handler when invoked
 * @param dlcis Array of DLCI channel contexts used internally
 * @param dlcis_cnt Length of array of DLCI channel contexts
 * @param receive_buf Receive buffer
 * @param receive_buf_size Sice of receive buffer in bytes
 * @param receive_timeout Timeout from data is received until data is read
 */
struct modem_cmux_config {
	modem_cmux_event_handler_t event_handler;
	void *event_handler_user_data;
	struct modem_cmux_dlci *dlcis;
	uint16_t dlcis_cnt;
	uint8_t *receive_buf;
	uint16_t receive_buf_size;
	k_timeout_t receive_timeout;
};

/**
 * @brief Initialize CMUX instance
 */
int modem_cmux_init(struct modem_cmux *cmux, const struct modem_cmux_config *config);

/**
 * @brief Connect CMUX instance
 * @details This will send a CMUX connect request to target on the serial bus. If successful,
 * DLCI channels can be now be opened using modem_cmux_dlci_open().
 * @param cmux CMUX instance
 * @param pipe pipe used to transmit data to and from bus
 * @note When connected, the bus pipe must not be used directly
 */
int modem_cmux_connect(struct modem_cmux *cmux, struct modem_pipe *pipe);

/**
 * @brief CMUX DLCI configuration
 * @param dlci_address DLCI channel address
 * @param receive_buf Receive buffer used by pipe
 * @param receive_buf_size Size of receive buffer used by pipe
 */
struct modem_cmux_dlci_config {
	uint16_t dlci_address;
	uint8_t *receive_buf;
	uint16_t receive_buf_size;
};

/**
 * @brief Open DLCI channel on connected CMUX instance
 * @param cmux CMUX instance
 * @param config CMUX DLCI channel configuration
 * @param pipe Pipe context
 */
int modem_cmux_dlci_open(struct modem_cmux *cmux, struct modem_cmux_dlci_config *config,
			 struct modem_pipe *pipe);

/**
 * @brief Close DLCI channel on connected CMUX instance
 */
int modem_cmux_dlci_close(struct modem_pipe *pipe);

/**
 * @brief Close down and disconnect CMUX instance
 * @details This will close all open DLCI channels, and close down the CMUX connection.
 * @note When disconnected, the bus pipe can be used directly again
 */
int modem_cmux_disconnect(struct modem_cmux *cmux);

#endif /* ZEPHYR_DRIVERS_MODEM_MODEM_CMUX */
```

## inc/modem_pipe.h
```c
/*
 * Copyright (c) 2022 Trackunit Corporation
 *
 * SPDX-License-Identifier: Apache-2.0
 */

#include <zephyr/types.h>
#include <zephyr/kernel.h>

#ifndef ZEPHYR_DRIVERS_MODEM_MODEM_PIPE
#define ZEPHYR_DRIVERS_MODEM_MODEM_PIPE

struct modem_pipe;

enum modem_pipe_event {
	/** @brief Data ready to be received through pipe */
	MODEM_PIPE_EVENT_RECEIVE_READY = 0,
	/** @brief Pipe was closed */
	MODEM_PIPE_EVENT_CLOSED,
};

typedef void (*modem_pipe_event_handler_t)(struct modem_pipe *pipe, enum modem_pipe_event event,
					   void *user_data);

typedef int (*modem_pipe_event_handler_set_t)(struct modem_pipe *pipe,
					      modem_pipe_event_handler_t handler, void *user_data);

typedef int (*modem_pipe_transmit_t)(struct modem_pipe *pipe, const uint8_t *buf, size_t size);

typedef int (*modem_pipe_receive_t)(struct modem_pipe *pipe, uint8_t *buf, size_t size);

struct modem_pipe_driver_api {
	modem_pipe_event_handler_set_t event_handler_set;
	modem_pipe_transmit_t transmit;
	modem_pipe_receive_t receive;
};

struct modem_pipe {
	void *data;
	struct modem_pipe_driver_api *api;
};

/**
 * @brief Set event handler
 * @note The modem pipe implementation must ensure the pipe belongs to the context which the pipe
 * is connected to.
 */
static inline int modem_pipe_event_handler_set(struct modem_pipe *pipe,
					       modem_pipe_event_handler_t handler, void *user_data)
{
	return pipe->api->event_handler_set(pipe, handler, user_data);
}

/**
 * @brief Transmit data through pipe
 * @note Returns immediately
 * @param pipe Pipe to transmit through
 * @param buf Destination for reveived data
 * @param size Capacity of destination for recevied data
 * @return Number of bytes placed in pipe
 */
static inline int modem_pipe_transmit(struct modem_pipe *pipe, const uint8_t *buf, size_t size)
{
	return pipe->api->transmit(pipe, buf, size);
}

/**
 * @brief Reveive data through pipe
 * @note Returns immediately
 * @param pipe Pipe to receive from
 * @param buf Destination for reveived data
 * @param size Capacity of destination for recevied data
 * @return Number of bytes received from pipe
 */
static inline int modem_pipe_receive(struct modem_pipe *pipe, uint8_t *buf, size_t size)
{
	return pipe->api->receive(pipe, buf, size);
}

#endif /* ZEPHYR_DRIVERS_MODEM_MODEM_PIPE */
```

## inc/modem_pipe_uart.h
```c
/*
 * Copyright (c) 2022 Trackunit Corporation
 *
 * SPDX-License-Identifier: Apache-2.0
 */

#include <zephyr/kernel.h>
#include <zephyr/types.h>
#include <zephyr/device.h>
#include <zephyr/sys/ring_buffer.h>

#include "modem_pipe.h"

#ifndef ZEPHYR_DRIVERS_MODEM_MODEM_PIPE_UART
#define ZEPHYR_DRIVERS_MODEM_MODEM_PIPE_UART

struct modem_pipe_uart {
	const struct device *uart;
	struct ring_buf rx_rdb[2];
	uint8_t rx_rdb_used;
	struct ring_buf tx_rb;
	struct modem_pipe *pipe;
	modem_pipe_event_handler_t pipe_event_handler;
	void *pipe_event_handler_user_data;
	bool opened;
};

struct modem_pipe_uart_config {
	const struct device *uart;
	uint8_t *rx_buf;
	uint32_t rx_buf_size;
	uint8_t *tx_buf;
	uint32_t tx_buf_size;
};

/**
 * @brief Initialize modem UART pipe
 */
int modem_pipe_uart_init(struct modem_pipe_uart *context,
			 const struct modem_pipe_uart_config *config);

int modem_pipe_uart_open(struct modem_pipe_uart *context, struct modem_pipe *pipe);

int modem_pipe_uart_close(struct modem_pipe *pipe);

#endif /* ZEPHYR_DRIVERS_MODEM_MODEM_PIPE_UART */
```

## inc/modem_ppp.h
```c
#include <zephyr/kernel.h>
#include <zephyr/types.h>
#include <zephyr/net/net_if.h>
#include <zephyr/net/net_pkt.h>

#include "modem_pipe.h"

#ifndef ZEPHYR_DRIVERS_MODEM_MODEM_PPP
#define ZEPHYR_DRIVERS_MODEM_MODEM_PPP

enum modem_ppp_receive_state {
	/* Searching for start of frame and header */
	MODEM_PPP_RECEIVE_STATE_HDR_SOF = 0,
	MODEM_PPP_RECEIVE_STATE_HDR_FF,
	MODEM_PPP_RECEIVE_STATE_HDR_7D,
	MODEM_PPP_RECEIVE_STATE_HDR_23,
	/* Writing bytes to network packet */
	MODEM_PPP_RECEIVE_STATE_WRITING,
	/* Unescaping next byte before writing to network packet */
	MODEM_PPP_RECEIVE_STATE_UNESCAPING,
};

struct modem_ppp {
	/* Network interface receiving PPP network packets */
	struct net_if *net_iface;

	/* Wrapped PPP frames are sent and received through this pipe */
	struct modem_pipe *pipe;

	/* Buffer used for processing received data */
	uint8_t *rx_buf;
	size_t rx_buf_len;
	size_t rx_buf_size;

	/* Receive PPP frame state */
	enum modem_ppp_receive_state receive_state;

	/* Allocated network packet being created */
	struct net_pkt *pkt;

	/* Network packet to send is wrapped into in this buffer */
	uint8_t *tx_buf;
	size_t tx_buf_len;
	size_t tx_buf_size;

	/* Synchronize */
	struct k_mutex lock;

	/* Indicate if attached */
	bool attached;
};

/**
 * @brief Contains modem PPP instance confuguration data
 * @param rx_buf Buffer for unwrapping PPP frame
 * @param rx_buf_size Size of RX buffer, should be the same size as network buffer
 * @param tx_buf Buffer for wrapping network packet in PPP frame
 * @param tx_buf_size Size of TX buffer, which should be twice the size of network buffer
 */
struct modem_ppp_config {
	uint8_t *rx_buf;
	size_t rx_buf_size;
	uint8_t *tx_buf;
	size_t tx_buf_size;
};

int modem_ppp_init(struct modem_ppp *ppp, struct modem_ppp_config *config);

/**
 * @brief Attach pipe to instance
 * @param ppp Modem PPP instance
 * @param pipe Pipe to attach to modem PPP instance
 * @param iface Network interface receiving PPP network packets
 */
int modem_ppp_attach(struct modem_ppp *ppp, struct modem_pipe *pipe, struct net_if *iface);

/**
 * @brief Wrap network packet in PPP frame and send it
 * @param ppp Modem PPP context
 * @param pkt Network packet to be wrapped and sent
 */
int modem_ppp_send(struct modem_ppp *ppp, struct net_pkt *pkt);

/**
 * @brief Release pipe from instance
 * @param ppp Modem PPP instance
 */
int modem_ppp_release(struct modem_ppp *ppp);

#endif /* ZEPHYR_DRIVERS_MODEM_MODEM_PPP */
```

## inc/modem_shell.h
```c
#ifndef ZEPHYR_DRIVERS_MODEM_SHELL
#define ZEPHYR_DRIVERS_MODEM_SHELL

#ifdef __cplusplus
extern "C" {
#endif

void tumodem_send_at_cmd(const char *atcmd_str);

#ifdef __cplusplus
}
#endif
#endif
```

## src/modem_cmd.c
```c
/*
 * Copyright (c) 2022 Trackunit Corporation
 *
 * SPDX-License-Identifier: Apache-2.0
 */

#include <zephyr/logging/log.h>
LOG_MODULE_REGISTER(modem_cmd);

#include <zephyr/kernel.h>
#include <string.h>

#include "modem_cmd.h"

#define MODEM_CMD_MATCHES_INDEX_RESPONSE        (0)
#define MODEM_CMD_MATCHES_INDEX_ABORT           (1)
#define MODEM_CMD_MATCHES_INDEX_UNSOL           (2)

#define MODEM_CMD_SCRIPT_STATUS_RUNNING_BIT     (0)

#define MODEM_CMD_EVENT_SCRIPT_ABORTED          (BIT(0))
#define MODEM_CMD_EVENT_SCRIPT_STOPPED          (BIT(1))

#define MODEM_CMD_SCRIPT_ABORT_TIMEOUT          (K_MSEC(500))

static void modem_cmd_script_stop(struct modem_cmd *cmd)
{
	uint32_t events;

	/* Handle result */
	if (cmd->script_cmd_it == cmd->script->script_cmds_size) {
		LOG_DBG("%s: complete", cmd->script->name);

		events = MODEM_CMD_EVENT_SCRIPT_STOPPED;
	} else {
		LOG_WRN("%s: aborted", cmd->script->name);

		events = MODEM_CMD_EVENT_SCRIPT_ABORTED;
	}

	/* Clear script */
	cmd->script = NULL;

	/* Clear response and abort commands */
	cmd->matches[MODEM_CMD_MATCHES_INDEX_ABORT] = NULL;
	cmd->matches_size[MODEM_CMD_MATCHES_INDEX_ABORT] = 0;
	cmd->matches[MODEM_CMD_MATCHES_INDEX_RESPONSE] = NULL;
	cmd->matches_size[MODEM_CMD_MATCHES_INDEX_RESPONSE] = 0;

	/* Post script event */
	k_event_post(&cmd->script_event, events);
}

static void modem_cmd_script_next(struct modem_cmd *cmd, bool initial)
{
	/* Advance iterator if not initial */
	if (initial == true) {
		/* Reset iterator */
		cmd->script_cmd_it = 0;
	} else {
		/* Advance iterator */
		cmd->script_cmd_it++;
	}

	/* Check if end of script reached */
	if (cmd->script_cmd_it == cmd->script->script_cmds_size) {
		modem_cmd_script_stop(cmd);

		return;
	}

	LOG_DBG("%s: step: %u", cmd->script->name, cmd->script_cmd_it);

	/* Update response command handlers */
	cmd->matches[MODEM_CMD_MATCHES_INDEX_RESPONSE] =
		&cmd->script->script_cmds[cmd->script_cmd_it].response_match;

	cmd->matches_size[MODEM_CMD_MATCHES_INDEX_RESPONSE] = 1;

	/* Initialize response match */
	cmd->matches[MODEM_CMD_MATCHES_INDEX_RESPONSE][0].matching = true;

	/* Check if request must be sent */
	if (strlen(cmd->script->script_cmds[cmd->script_cmd_it].request) == 0) {
		return;
	}

	/* Send request */
	modem_cmd_send(cmd, cmd->script->script_cmds[cmd->script_cmd_it].request);}

static void modem_cmd_script_start(struct modem_cmd *cmd, const struct modem_cmd_script *script)
{
	/* Save script */
	cmd->script = script;

	/* Set abort matches */
	cmd->matches[MODEM_CMD_MATCHES_INDEX_ABORT] = script->abort_matches;
	cmd->matches_size[MODEM_CMD_MATCHES_INDEX_ABORT] = script->abort_matches_size;

	LOG_DBG("%s", cmd->script->name);

	/* Set first script command */
	modem_cmd_script_next(cmd, true);
}

static void modem_cmd_script_run_handler(struct k_work *item)
{
	struct modem_cmd_script_run_work_item *script_run_work =
		(struct modem_cmd_script_run_work_item *)item;

	struct modem_cmd *cmd = script_run_work->cmd;
	const struct modem_cmd_script *script = script_run_work->script;

	/* Start script */
	modem_cmd_script_start(cmd, script);
}

static void modem_cmd_script_abort_handler(struct k_work *item)
{
	struct modem_cmd_script_abort_work_item *script_abort_work =
		(struct modem_cmd_script_abort_work_item *)item;

	struct modem_cmd *cmd = script_abort_work->cmd;

	/* Validate script is currently running */
	if (cmd->script == NULL) {
		return;
	}

	/* Abort script */
	modem_cmd_script_stop(cmd);
}

static void modem_cmd_parse_reset(struct modem_cmd *cmd)
{
	/* Reset parameters used for parsing */
	cmd->receive_buf_len = 0;
	cmd->delimiter_match_len = 0;
	cmd->argc = 0;
	cmd->parse_match = NULL;

	/* Reset matches matching state */
	for (uint16_t i = 0; i < ARRAY_SIZE(cmd->matches); i++) {
		for (uint16_t u = 0; u < cmd->matches_size[i]; u++) {
			cmd->matches[i][u].matching = true;
		}
	}
}

/* Exact match is stored at end of receive buffer */
static void modem_cmd_parse_save_match(struct modem_cmd *cmd)
{
	uint8_t *argv;

	/* Store length of match including NULL to avoid overwriting it if buffer overruns */
	cmd->parse_match_len = cmd->receive_buf_len + 1;

	/* Copy match to end of receive buffer */
	argv = &cmd->receive_buf[cmd->receive_buf_size - cmd->parse_match_len];

	/* Copy match to end of receive buffer (excluding NULL) */
	memcpy(argv, &cmd->receive_buf[0], cmd->parse_match_len - 1);

	/* Save match */
	cmd->argv[cmd->argc] = argv;

	/* Terminate match */
	cmd->receive_buf[cmd->receive_buf_size - 1] = '\0';

	/* Increment argument count */
	cmd->argc++;
}

static bool modem_cmd_parse_find_match(struct modem_cmd *cmd)
{
	/* Find in all matches types */
	for (uint16_t i = 0; i < ARRAY_SIZE(cmd->matches); i++) {
		/* Find in all matches of matches type */
		for (uint16_t u = 0; u < cmd->matches_size[i]; u++) {
			/* Validate match config is matching previous bytes */
			if (cmd->matches[i][u].matching == false) {
				continue;
			}

			/* Validate receive length does not exceed match length */
			if (cmd->matches[i][u].match_size < cmd->receive_buf_len) {
				cmd->matches[i][u].matching = false;

				continue;
			}

			/* Validate match config also matches new byte */
			if ((cmd->matches[i][u].match[cmd->receive_buf_len - 1]) !=
			(cmd->receive_buf[cmd->receive_buf_len - 1])) {
				/* Validate wildcards accepted */
				if (cmd->matches[i][u].wildcards == false) {
					cmd->matches[i][u].matching = false;

					continue;
				}

				/* Validate wildcard */
				if (cmd->matches[i][u].match[cmd->receive_buf_len - 1] != '?') {
					cmd->matches[i][u].matching = false;

					continue;
				}
			}

			/* Validate match is complete */
			if ((cmd->receive_buf_len) < cmd->matches[i][u].match_size) {
				continue;
			}

			/* Complete match found */
			cmd->parse_match = &cmd->matches[i][u];
			cmd->parse_match_type = i;

			return true;
		}
	}

	return false;
}

static bool modem_cmd_parse_is_separator(struct modem_cmd *cmd)
{
	for (uint16_t i = 0; i < cmd->parse_match->separators_size; i++) {
		if ((cmd->parse_match->separators[i]) ==
		    (cmd->receive_buf[cmd->receive_buf_len - 1])) {
			return true;
		}
	}

	return false;
}

static bool modem_cmd_parse_end_del_start(struct modem_cmd *cmd)
{
	for (uint16_t i = 0; i < cmd->delimiter_size; i++) {
		if (cmd->receive_buf[cmd->receive_buf_len - 1] == cmd->delimiter[i]) {
			return true;
		}
	}

	return false;
}

static bool modem_cmd_parse_end_del_complete(struct modem_cmd *cmd)
{
	/* Validate length of end delimiter */
	if (cmd->receive_buf_len < cmd->delimiter_size) {
		return false;
	}

	/* Compare end delimiter with receive buffer content */
	return (memcmp(&cmd->receive_buf[cmd->receive_buf_len - cmd->delimiter_size],
		       cmd->delimiter, cmd->delimiter_size) == 0)
		       ? true
		       : false;
}

/* Receive chunk of bytes */
static bool modem_cmd_receive_bytes(struct modem_cmd *cmd)
{
	int ret;

	ret = modem_pipe_receive(cmd->pipe, cmd->work_buf, sizeof(cmd->work_buf));

	if (ret < 1) {
		return false;
	}

	cmd->work_buf_len = (uint16_t)ret;

	return true;
}

static void modem_cmd_on_command_received_unsol(struct modem_cmd *cmd)
{
	/* Callback */
	if (cmd->parse_match->callback != NULL) {
		cmd->parse_match->callback(cmd, (char **)cmd->argv, cmd->argc, cmd->user_data);
	}
}

static void modem_cmd_on_command_received_abort(struct modem_cmd *cmd)
{
	/* Callback */
	if (cmd->parse_match->callback != NULL) {
		cmd->parse_match->callback(cmd, (char **)cmd->argv, cmd->argc, cmd->user_data);
	}

	/* Abort script */
	modem_cmd_script_stop(cmd);
}

static void modem_cmd_on_command_received_resp(struct modem_cmd *cmd)
{
	/* Callback */
	if (cmd->parse_match->callback != NULL) {
		cmd->parse_match->callback(cmd, (char **)cmd->argv, cmd->argc, cmd->user_data);
	}

	/* Advance script */
	modem_cmd_script_next(cmd, false);
}

static bool modem_cmd_parse_find_catch_all_match(struct modem_cmd *cmd)
{
	/* Find in all matches types */
	for (uint16_t i = 0; i < ARRAY_SIZE(cmd->matches); i++) {
		/* Find in all matches of matches type */
		for (uint16_t u = 0; u < cmd->matches_size[i]; u++) {
			/* Validate match config is matching previous bytes */
			if (cmd->matches[i][u].match_size == 0) {
				cmd->parse_match = &cmd->matches[i][u];
				cmd->parse_match_type = i;

				return true;
			}
		}
	}

	return false;
}

static void modem_cmd_on_command_received(struct modem_cmd *cmd)
{
	switch (cmd->parse_match_type)
	{
	case MODEM_CMD_MATCHES_INDEX_UNSOL:
		modem_cmd_on_command_received_unsol(cmd);
		break;

	case MODEM_CMD_MATCHES_INDEX_ABORT:
		modem_cmd_on_command_received_abort(cmd);
		break;

	case MODEM_CMD_MATCHES_INDEX_RESPONSE:
		modem_cmd_on_command_received_resp(cmd);
		break;
	}

	LOG_DBG("\"%s\"", cmd->argv[0]);
}

static void modem_cmd_on_unknown_command_received(struct modem_cmd *cmd)
{
	/* Try to find catch all match */
	if (modem_cmd_parse_find_catch_all_match(cmd) == false) {
		LOG_DBG("\"%.*s\"", cmd->receive_buf_len - cmd->delimiter_size, cmd->receive_buf);

		return;
	}

	/* Terminate received command */
	cmd->receive_buf[cmd->receive_buf_len - cmd->delimiter_match_len] = '\0';

	/* Parse command */
	cmd->argv[0] = "";
	cmd->argv[1] = cmd->receive_buf;
	cmd->argc = 2;

	/* Invoke on response received */
	modem_cmd_on_command_received(cmd);
}

static void modem_cmd_process_byte(struct modem_cmd *cmd, uint8_t byte)
{
	/* Validate receive buffer not overrun */
	if (cmd->receive_buf_size == cmd->receive_buf_len) {
		LOG_WRN("Receive buffer overrun");
		modem_cmd_parse_reset(cmd);

		return;
	}

	/* Validate argv buffer not overrun */
	if (cmd->argc == cmd->argv_size) {
		LOG_WRN("Argv buffer overrun");
		modem_cmd_parse_reset(cmd);

		return;
	}

	/* Copy byte to receive buffer */
	cmd->receive_buf[cmd->receive_buf_len] = byte;
	cmd->receive_buf_len++;

	/* Validate end delimiter not complete */
	if (modem_cmd_parse_end_del_complete(cmd) == true) {
		/* Filter out empty lines */
		if (cmd->receive_buf_len == cmd->delimiter_size) {
			/* Reset parser */
			modem_cmd_parse_reset(cmd);

			return;
		}

		/* Check if match exists */
		if (cmd->parse_match == NULL) {
			/* Handle unknown command */
			modem_cmd_on_unknown_command_received(cmd);

			/* Reset parser */
			modem_cmd_parse_reset(cmd);

			return;
		}

		/* Check if trailing argument exists */
		if (cmd->parse_arg_len > 0) {
			cmd->argv[cmd->argc] =
				&cmd->receive_buf[cmd->receive_buf_len - cmd->delimiter_size -
						  cmd->parse_arg_len];
			cmd->receive_buf[cmd->receive_buf_len - cmd->delimiter_size] = '\0';
			cmd->argc++;
		}

		/* Handle received command */
		modem_cmd_on_command_received(cmd);

		/* Reset parser */
		modem_cmd_parse_reset(cmd);

		return;
	}

	/* Validate end delimiter not started */
	if (modem_cmd_parse_end_del_start(cmd) == true) {
		return;
	}

	/* Find matching command if missing */
	if (cmd->parse_match == NULL) {
		/* Find matching command */
		if (modem_cmd_parse_find_match(cmd) == false) {
			return;
		}

		/* Save match */
		modem_cmd_parse_save_match(cmd);

		/* Prepare argument parser */
		cmd->parse_arg_len = 0;

		return;
	}

	/* Check if separator reached */
	if (modem_cmd_parse_is_separator(cmd) == true) {
		/* Check if argument is empty */
		if (cmd->parse_arg_len == 0) {
			/* Save empty argument */
			cmd->argv[cmd->argc] = "";
		} else {
			/* Save pointer to start of argument */
			cmd->argv[cmd->argc] =
				&cmd->receive_buf[cmd->receive_buf_len - cmd->parse_arg_len - 1];

			/* Replace separator with string terminator */
			cmd->receive_buf[cmd->receive_buf_len - 1] = '\0';
		}

		/* Increment argument count */
		cmd->argc++;

		/* Reset parse argument length */
		cmd->parse_arg_len = 0;

		return;
	}

	/* Increment argument length */
	cmd->parse_arg_len++;
}

/* Process chunk of received bytes */
static void modem_cmd_process_bytes(struct modem_cmd *cmd)
{
	for (uint16_t i = 0; i < cmd->work_buf_len; i++) {
		modem_cmd_process_byte(cmd, cmd->work_buf[i]);
	}
}

static void modem_cmd_process_handler(struct k_work *item)
{
	struct modem_cmd_work_item *process_work = (struct modem_cmd_work_item *)item;
	struct modem_cmd *cmd = process_work->cmd;

	/* Receive all available data */
	while (modem_cmd_receive_bytes(cmd) == true) {
		/* Process all available data */
		modem_cmd_process_bytes(cmd);
	}
}

static void modem_cmd_pipe_event_handler(struct modem_pipe *pipe, enum modem_pipe_event event,
				  void *user_data)
{
	struct modem_cmd *cmd = (struct modem_cmd *)user_data;

	k_work_schedule(&cmd->process_work.dwork, cmd->process_timeout);
}

/*********************************************************
 * GLOBAL FUNCTIONS
 *********************************************************/
int modem_cmd_init(struct modem_cmd *cmd, const struct modem_cmd_config *config)
{
	/* Validate arguments */
	if ((cmd == NULL) || (config == NULL)) {
		return -EINVAL;
	}

	/* Validate config */
	if ((config->receive_buf == NULL) ||
	    (config->receive_buf_size == 0) ||
	    (config->argv == NULL) ||
	    (config->argv_size == 0) ||
	    (config->delimiter == NULL) ||
	    (config->delimiter_size == 0) ||
	    (config->unsol_matches == NULL) ||
	    (config->unsol_matches_size == 0)) {
		return -EINVAL;
	}

	/* Clear context */
	memset(cmd, 0x00, sizeof(*cmd));

	/* Configure command handler */
	cmd->pipe = NULL;
	cmd->user_data = config->user_data;
	cmd->receive_buf = config->receive_buf;
	cmd->receive_buf_size = config->receive_buf_size;
	cmd->argv = config->argv;
	cmd->argv_size = config->argv_size;
	cmd->delimiter = config->delimiter;
	cmd->delimiter_size = config->delimiter_size;
	cmd->matches[MODEM_CMD_MATCHES_INDEX_UNSOL] = config->unsol_matches;
	cmd->matches_size[MODEM_CMD_MATCHES_INDEX_UNSOL] = config->unsol_matches_size;
	cmd->process_timeout = config->process_timeout;

	/* Initialize work items */
	cmd->process_work.cmd = cmd;
	k_work_init_delayable(&cmd->process_work.dwork, modem_cmd_process_handler);

	cmd->script_run_work.cmd = cmd;
	k_work_init(&cmd->script_run_work.work, modem_cmd_script_run_handler);

	cmd->script_abort_work.cmd = cmd;
	k_work_init(&cmd->script_abort_work.work, modem_cmd_script_abort_handler);

	/* Initialize script event and set the script stopped event */
	k_event_init(&cmd->script_event);
	k_event_post(&cmd->script_event, MODEM_CMD_EVENT_SCRIPT_STOPPED);

	return 0;
}

int modem_cmd_attach(struct modem_cmd *cmd, struct modem_pipe *pipe)
{
	/* Validate arguments */
	if ((cmd == NULL) || (pipe == NULL)) {
		return -EINVAL;
	}

	/* Associate command handler with pipe */
	cmd->pipe = pipe;

	/* Reset parser */
	modem_cmd_parse_reset(cmd);

	/* Set pipe event handler */
	return modem_pipe_event_handler_set(pipe, modem_cmd_pipe_event_handler, cmd);
}

int modem_cmd_script_run(struct modem_cmd *cmd, const struct modem_cmd_script *script)
{
	uint32_t events;

	/* Validate arguments */
	if ((cmd == NULL) || (script == NULL)) {
		return -EINVAL;
	}

	/* Validate attached */
	if (cmd->pipe == NULL) {
		return -EPERM;
	}

	/* Validate script */
	if ((script->script_cmds == NULL) ||
	    (script->script_cmds_size == 0) ||
	    ((script->abort_matches != NULL) && (script->abort_matches_size == 0))) {
		return -EINVAL;
	}

	/* Validate run work not pending */
	if (k_work_is_pending(&cmd->script_run_work.work) == true) {
		return -EBUSY;
	}

	/* Get current script events */
	events = k_event_wait(&cmd->script_event,
				MODEM_CMD_EVENT_SCRIPT_ABORTED |
				MODEM_CMD_EVENT_SCRIPT_STOPPED,
				false, K_NO_WAIT);

	/* Validate script terminated */
	if ((events & (MODEM_CMD_EVENT_SCRIPT_ABORTED | MODEM_CMD_EVENT_SCRIPT_STOPPED)) == 0) {
		return -EBUSY;
	}

	/* Clear script events */
	k_event_clear(&cmd->script_event,
		      MODEM_CMD_EVENT_SCRIPT_ABORTED | MODEM_CMD_EVENT_SCRIPT_STOPPED);

	/* Initialize work item data */
	cmd->script_run_work.script = script;

	/* Submit script run work */
	k_work_submit(&cmd->script_run_work.work);

	return 0;
}

void modem_cmd_script_abort(struct modem_cmd *cmd)
{
	uint32_t events;

	/* Validate arguments */
	if (cmd == NULL) {
		return;
	}

	/* Validate abort work not pending */
	if (k_work_is_pending(&cmd->script_abort_work.work) == true) {
		return;
	}

	/* Get current script events */
	events = k_event_wait(&cmd->script_event,
				MODEM_CMD_EVENT_SCRIPT_ABORTED |
				MODEM_CMD_EVENT_SCRIPT_STOPPED,
				false, K_NO_WAIT);

	/* Validate script running */
	if ((events & (MODEM_CMD_EVENT_SCRIPT_ABORTED | MODEM_CMD_EVENT_SCRIPT_STOPPED)) > 0) {
		return;
	}

	/* Submit script abort work */
	k_work_submit(&cmd->script_abort_work.work);
}

int modem_cmd_script_wait(struct modem_cmd *cmd, k_timeout_t timeout)
{
	uint32_t events;

	/* Validate arguments */
	if (cmd == NULL) {
		return -EINVAL;
	}

	/* Wait for script aborted, stopped or timed out */
	events = k_event_wait(&cmd->script_event,
			      MODEM_CMD_EVENT_SCRIPT_ABORTED |
			      MODEM_CMD_EVENT_SCRIPT_STOPPED,
			      false, timeout);

	/* Check if timeout occured */
	if ((events & (MODEM_CMD_EVENT_SCRIPT_ABORTED | MODEM_CMD_EVENT_SCRIPT_STOPPED)) == 0) {
		return -EBUSY;
	}

	/* Return appropriate script result */
	return (events == MODEM_CMD_EVENT_SCRIPT_STOPPED) ? 0 : -EAGAIN;
}

int modem_cmd_send(struct modem_cmd *cmd, const char *str)
{
	int ret;
	int sent;

	/* Validate arguments */
	if ((cmd == NULL) || (str == NULL)) {
		return -EINVAL;
	}

	/* Validate attached */
	if (cmd->pipe == NULL) {
		return -EPERM;
	}

	ret = modem_pipe_transmit(cmd->pipe, str, strlen(str));

	if (ret < 0) {
		return ret;
	}

	sent = ret;

	ret = modem_pipe_transmit(cmd->pipe, cmd->delimiter, cmd->delimiter_size);

	if (ret < 0) {
		return ret;
	}

	LOG_DBG("%s", str);

	return sent + ret;
}

uint32_t modem_cmd_send_sync_event(struct modem_cmd *cmd, const char *str, struct k_event *event,
				   uint32_t events, k_timeout_t timeout)
{
	int ret;

	/* Validate arguments */
	if ((cmd == NULL) || (str == NULL) || (event == NULL) || events == 0) {
		return -EINVAL;
	}

	/* Clear events */
	k_event_clear(event, events);

	/* Send command */
	ret = modem_cmd_send(cmd, str);

	if (ret < 0) {
		return ret;
	}

	/* Await events or timeout */
	return k_event_wait(event, events, false, timeout);
}

int modem_cmd_release(struct modem_cmd *cmd)
{
	/* Verify attached */
	if (cmd->pipe == NULL) {
		return 0;
	}

	/* Release pipe */
	modem_pipe_event_handler_set(cmd->pipe, NULL, NULL);

	/* Cancel process work */
	struct k_work_sync sync;
	k_work_cancel_delayable_sync(&cmd->process_work.dwork, &sync);

	cmd->pipe = NULL;

	return 0;
}
```

## src/modem_pipe_uart.c
```c
/*
 * Copyright (c) 2022 Trackunit Corporation
 *
 * SPDX-License-Identifier: Apache-2.0
 */

#include <string.h>
#include <zephyr/kernel.h>
#include <zephyr/drivers/uart.h>

#include "modem_pipe_uart.h"

#define MODEM_UART_EVENTS_RX_READY (BIT(0))
#define MODEM_UART_EVENTS_TX_IDLE  (BIT(1))

static void modem_pipe_uart_invoke_receive_ready_event(struct modem_pipe_uart *context)
{
	/* Validate event handler set */
	if (context->pipe_event_handler == NULL) {
		return;
	}

	context->pipe_event_handler(context->pipe, MODEM_PIPE_EVENT_RECEIVE_READY,
				    context->pipe_event_handler_user_data);
}

static void modem_pipe_uart_irq_handler_rx_ready(struct modem_pipe_uart *context)
{
	/* Variables */
	uint32_t size;
	uint8_t *buffer;
	int ret;

	/* Reserve rx ring buffer */
	size = ring_buf_put_claim(&context->rx_rdb[context->rx_rdb_used], &buffer, UINT32_MAX);

	/* Validate rx ring buffer is not full */
	if (size == 0) {
		/* Release rx ring buffer */
		ring_buf_put_finish(&context->rx_rdb[context->rx_rdb_used], 0);

		/* Disable rx IRQ */
		uart_irq_rx_disable(context->uart);

		return;
	}

	/* Try to read from fifo */
	ret = uart_fifo_read(context->uart, buffer, size);

	/* Release rx ring buffer */
	ring_buf_put_finish(&context->rx_rdb[context->rx_rdb_used], (uint32_t)ret);

	/* Invoke event if data was received */
	if (0 < ret) {
		modem_pipe_uart_invoke_receive_ready_event(context);
	}
}

static void modem_pipe_uart_irq_handler_tx_ready(struct modem_pipe_uart *context)
{
	/* Variables */
	uint32_t size;
	uint8_t *buffer;
	int ret;

	/* Check if tx ring buffer is empty */
	if (ring_buf_size_get(&context->tx_rb) == 0) {
		/* Disable UART tx IRQ */
		uart_irq_tx_disable(context->uart);

		/* Release tx ring buffer */
		ring_buf_get_finish(&context->tx_rb, 0);

		return;
	}

	/* Reserve tx ring buffer */
	size = ring_buf_get_claim(&context->tx_rb, &buffer, UINT32_MAX);

	/* Try to write to fifo */
	ret = uart_fifo_fill(context->uart, buffer, size);

	/* Release tx ring buffer */
	ring_buf_get_finish(&context->tx_rb, (uint32_t)ret);
}

static void modem_pipe_uart_irq_handler(const struct device *uart, void *user_data)
{
	struct modem_pipe_uart *context = (struct modem_pipe_uart *)user_data;

	if (uart_irq_update(uart) != 1) {
		return;
	}

	if (uart_irq_rx_ready(uart) == 1) {
		modem_pipe_uart_irq_handler_rx_ready(context);
	}

	if (uart_irq_tx_ready(uart) == 1) {
		modem_pipe_uart_irq_handler_tx_ready(context);
	}
}

static void modem_pipe_uart_flush(struct modem_pipe_uart *context)
{
	uint8_t c;

	while (0 < uart_fifo_read(context->uart, &c, 1)) {
		continue;
	}
}

static int modem_pipe_uart_pipe_event_handler_set(struct modem_pipe *pipe,
						  modem_pipe_event_handler_t handler,
						  void *user_data)
{
	struct modem_pipe_uart *context = (struct modem_pipe_uart *)pipe->data;

	/* Validate pipe belongs to this context */
	if ((context->pipe != pipe)) {
		return -EPERM;
	}

	uart_irq_rx_disable(context->uart);
	uart_irq_tx_disable(context->uart);

	context->pipe = pipe;
	context->pipe_event_handler = handler;
	context->pipe_event_handler_user_data = user_data;

	uart_irq_rx_enable(context->uart);
	uart_irq_tx_enable(context->uart);

	return 0;
}

static int modem_pipe_uart_transmit(struct modem_pipe *pipe, const uint8_t *buf, uint32_t size)
{
	struct modem_pipe_uart *context = (struct modem_pipe_uart *)pipe->data;

	int written;

	uart_irq_tx_disable(context->uart);

	written = ring_buf_put(&context->tx_rb, buf, size);

	uart_irq_tx_enable(context->uart);

	return written;
}

static int modem_pipe_uart_receive(struct modem_pipe *pipe, uint8_t *buf, uint32_t size)
{
	struct modem_pipe_uart *context = (struct modem_pipe_uart *)pipe->data;
	uint32_t read_bytes = 0;
	uint8_t rx_rdb_unused = (context->rx_rdb_used == 1) ? 0 : 1;

	/* Read data from unused ring double buffer first */
	read_bytes += ring_buf_get(&context->rx_rdb[rx_rdb_unused], buf, size);

	/* Check if data remains in unused buffer */
	if (ring_buf_is_empty(&context->rx_rdb[rx_rdb_unused]) == false) {
		return (int)read_bytes;
	}

	/* Swap rx ring double buffer */
	uart_irq_rx_disable(context->uart);

	context->rx_rdb_used = rx_rdb_unused;

	uart_irq_rx_enable(context->uart);

	/* Read data from previously used buffer */
	rx_rdb_unused = (context->rx_rdb_used == 1) ? 0 : 1;

	read_bytes += ring_buf_get(&context->rx_rdb[rx_rdb_unused], &buf[read_bytes],
				   (size - read_bytes));

	uart_irq_rx_disable(context->uart);

	/* Invoke receive ready event if data remains */
	if (ring_buf_is_empty(&context->rx_rdb[context->rx_rdb_used]) == false) {
		modem_pipe_uart_invoke_receive_ready_event(context);
	}

	uart_irq_rx_enable(context->uart);

	return (int)read_bytes;
}

struct modem_pipe_driver_api modem_pipe_uart_api = {
	.event_handler_set = modem_pipe_uart_pipe_event_handler_set,
	.transmit = modem_pipe_uart_transmit,
	.receive = modem_pipe_uart_receive,
};

int modem_pipe_uart_init(struct modem_pipe_uart *context,
			 const struct modem_pipe_uart_config *config)
{
	/* Validate arguments */
	if (context == NULL || config == NULL) {
		return -EINVAL;
	}

	/* Validate config */
	if ((config->uart == NULL) || (config->rx_buf == NULL) || (config->rx_buf_size < 1) ||
	    (config->tx_buf == NULL) || (config->tx_buf_size < 1)) {
		return -EINVAL;
	}

	/* Clear CMUX context */
	memset(context, 0x00, sizeof(*context));

	/* Copy configuration to context */
	context->uart = config->uart;

	/* Initialize rx ring double buffers */
	uint32_t rx_double_buf_size = config->rx_buf_size / 2;
	ring_buf_init(&context->rx_rdb[0], rx_double_buf_size, config->rx_buf);
	ring_buf_init(&context->rx_rdb[1], rx_double_buf_size, &config->rx_buf[rx_double_buf_size]);

	/* Initialize tx ring buffer */
	ring_buf_init(&context->tx_rb, config->tx_buf_size, config->tx_buf);

	uart_irq_rx_disable(context->uart);
	uart_irq_tx_disable(context->uart);

	uart_irq_callback_user_data_set(context->uart, modem_pipe_uart_irq_handler, context);

	return 0;
}

int modem_pipe_uart_open(struct modem_pipe_uart *context, struct modem_pipe *pipe)
{
	/* Validate arguments */
	if ((context == NULL) || (pipe == NULL)) {
		return -EINVAL;
	}

	/* Validate closed */
	if (context->opened == true) {
		return -EPERM;
	}

	/* Configure pipe */
	pipe->data = context;
	pipe->api = &modem_pipe_uart_api;

	/* Update context */
	context->pipe = pipe;
	context->opened = true;

	/* Flush UART */
	modem_pipe_uart_flush(context);

	/* Enable UART */
	uart_irq_rx_enable(context->uart);
	uart_irq_tx_enable(context->uart);

	return 0;
}

int modem_pipe_uart_close(struct modem_pipe *pipe)
{
	struct modem_pipe_uart *context = (struct modem_pipe_uart *)pipe->data;

	/* Validate arguments */
	if (pipe == NULL) {
		return -EINVAL;
	}

	/* Validate opened */
	if (context->opened == false) {
		return -EPERM;
	}

	/* Clear pipe */
	memset(pipe, 0x00, sizeof(*pipe));

	/* Update context */
	context->pipe = NULL;
	context->pipe_event_handler = NULL;
	context->pipe_event_handler_user_data = NULL;
	context->opened = false;

	uart_irq_rx_disable(context->uart);
	uart_irq_tx_disable(context->uart);

	return 0;
}
```
